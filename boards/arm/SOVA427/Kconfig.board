## boards/arm/SOVA427/Kconfig.defconfig
```kconfig
if BOARD_SOVA427

config BOARD
	default "SOVA427"

if NETWORKING

config NET_L2_ETHERNET
	default y

endif # NETWORKING
endif # BOARD_SOVA427
```

## drivers/adc/Kconfig.ads869x
```kconfig
config ADC_ADS869X
	bool "ADS8694/ADS8698 driver"
	depends on SPI
	help
	  Enable ADS8694/ADS8698 ADC driver.

	  The ADS8694/ADS8698 are 4/8 channel 18-bit A/D converters
	  with SPI interface.

if ADC_ADS869X

config ADC_ADS869X_ACQUISITION_THREAD_STACK_SIZE
	int "Stack size for the ADC data acquisition thread"
	default 512
	help
	  Size of the stack used for the internal data acquisition
	  thread.

config ADC_ADS869X_ACQUISITION_THREAD_PRIO
	int "Priority for the ADC data acquisition thread"
	default 14
	help
	  Priority level for the internal ADC data acquisition thread.

endif
```

## drivers/dac/Kconfig.dac104
```kconfig
config DAC_DAC104
	bool "TI DACx0508 DAC driver"
	depends on SPI
	help
	  Enable the driver for the TI DAC104.
```

## drivers/dac/Kconfig.dac6311
```kconfig
config DAC_DAC6311
	bool "TI DAC6311 DAC driver"
	depends on SPI
	help
	  Enable the driver for the TI DAC6311.
```

## drivers/flash/Kconfig.eeprom
```kconfig
config FLASH_EEPROM
	bool "Convert eeprom parent device to FLASH"
	help
	  Convert eeprom parent device to FLASH

config FLASH_EEPROM_PSEUDO_ERASE
	bool "Write FLASH_EEPROM_ERASE_SYMBOL when calling erase flash_driver_api"

config FLASH_EEPROM_ERASE_SYMBOL
	hex "Writeable character when erasing flash"
	default 0xFF
	depends on FLASH_EEPROM_PSEUDO_ERASE
```

## drivers/misc/adg708/Kconfig
```kconfig
module = ADG708
module-str = adg708_mux
source "subsys/logging/Kconfig.template.log_config"

config ADG708
	bool "ADG708 multiplexer driver"
	help
	  Enable driver for ADG708 multiplexer
```

## dts/bindings/adc/ti,ads8698.yaml
```yaml
description: Texas Instruments ADS8698 Analog to digital converter

include: [adc-controller.yaml, spi-device.yaml]
compatible: "ti,ads8698-adc"
```

## dts/bindings/dac/ti,dac104.yaml
```yaml
description: Texas Instruments DAC104S085 digital to analog converter

include: [dac-controller.yaml, spi-device.yaml]

io-channel-cells:
    - output

properties:
    "#io-channel-cells":
      const: 1

compatible: "ti,dac104-dac"
```

## dts/bindings/dac/ti,dac6311.yaml
```yaml
description: Texas Instruments DAC6311 10bit, Single Channel, 80uA, 2.0V-5.5V DAC

include: [dac-controller.yaml, spi-device.yaml]

io-channel-cells:
    - output

properties:
    "#io-channel-cells":
      const: 1

compatible: "ti,dac6311-dac"
```

## dts/bindings/gpio/lmt,bush-header.yaml
```yaml
description: |
        GPIO pins exposed on LMT Birds&Bushes connector.
        The B&B layout provides one 40 pin connector, with 
        6 general purpose IO channels, 1 power channel,
        3 input/output power channels and 1 special channel

        1   +5            2 GND      |  pwr                                         
        3   VDDIO         4 GND      |  pwr_io   
        5   io0/sync      6 io1/data |  chnl_s   
        7   io2/irq       8 io3/data |           
        9   io0/sync     10 io1/data |  chnl_a   
        11  io2/irq      12 io3/data |           
        13  io0/sync     14 io1/data |  chnl_b   
        15  io2/irq      16 io3/data |           
        17  VDDIO        18 GND      |  pwr_io   
        19  io0/sync     20 io1/data |  chnl_c   
        21  io2/irq      22 io3/data |          
        23  io0/sync     24 io1/data |  chnl_d   
        25  io2/irq      25 io3/data |           
        27  io0/sync     28 io1/data |  chnl_e   
        29  io2/irq      30 io3/data |           
        31  VDDIO        32 GND      |  pwr_io 
        33               34          |  special (33-39)
        35               36          |
        37               38          |
        39               40 Shield   |
        
        chnl_X (x - a,b,c,d,e)
        IO_Name | io0/sync | io1/data | io2/irq | io3/data |
        ----------------------------------------------------|
        D_DATA  |  ddata0   | ddata1   | ddata2  | ddata3   |
        ----------------------------------------------------|
        A_DATA  |  adata0   | adata1   | adata2  | adata3   |
        ----------------------------------------------------|
        SPI     |  MOSI     | MISO     | CLK     | -        |
        ----------------------------------------------------|
        UART_FC |           |          | RTS     | CTS      |
        UART_IO |  TXD      | RXD      | IO2     | IO3      |
        UART    |           |          | ---     | ---      |
        CAN 2.0B|           |          | ---     | ---      |
        ----------------------------------------------------|
        I2C     |  SCL      | SDA      | ---     | ---      |
        I2C_ID  |           |          | IRQb    | RSTb     |
        ----------------------------------------------------|
        JTAG    |  TDO      | TDI      | TCK     | TMS      |
        ----------------------------------------------------|
        GPIO    | GPIO_0    | GPIO_1   | GPIO_2  | GPIO_3   |        


compatible: "lmt,bb-header"

include: [gpio-nexus.yaml, base.yaml]
```

## dts/bindings/mtd/eeprom-flash.yaml
```yaml
include: base.yaml

description: Convert EEPROM device to Flash

properties:
  page-count:
    type: int
    required: true
  page-size:
    type: int
    required: true

compatible: "eeprom-flash"
```

## dts/bindings/pinctrl/adi,adg708.yaml
```yaml
# SPDX-License-Identifier: Apache-2.0

description: Analog Devices ADG708 8 channel MUX

compatible: "adi,adg708"

include: [base.yaml]

properties:

    label:
      required: true

    ctrl-gpios:
      type: phandle-array
      required: true
```

## dts/bindings/w1/zephyr,w1-gpio.yaml
```yaml
description: W1 over gpio

compatible: "zephyr,w1-gpio"

include: [base.yaml, w1-controller.yaml]


properties:
    ctrl-gpios:
      type: phandle-array
      required: true
    # counter:
    #   type: phandle
    #   required: false
    # counter-channel:
    #   type: int
    #   default: 0
    #   required: false
```
